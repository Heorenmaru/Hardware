/*
 * st7567a.c
 *
 *  Created on: 10 мая 2025 г.
 *      Author: Heorenmaru
 */


#include "st7567a.h"


void Dcmd(st7567Handler* h, uint8_t c){
	h->nss.port->ODR &= ~h->nss.pin;
	h->dc.port->ODR &= ~h->dc.pin;
	HAL_SPI_Transmit(h->spi,&c,1,150);
	h->nss.port->ODR |= h->nss.pin;
	h->dc.port->ODR |= h->dc.pin;
}

void Ddat(st7567Handler* h, uint8_t c){
	h->nss.port->ODR &= ~h->nss.pin;
	h->dc.port->ODR |= h->dc.pin;
	HAL_SPI_Transmit(h->spi,&c,1,150);
	h->nss.port->ODR |= h->nss.pin;
	h->dc.port->ODR |= h->dc.pin;
}


void D_WriteByte(st7567Handler* h, uint8_t TxData){
    HAL_SPI_Transmit(h->spi,&TxData,1,150);
}


void D_WriteScreen(st7567Handler* h, uint8_t* datas)
{

////	uint16_t x,y;
//	Epaper_Write_Command(0x4E);   // set RAM x address count to 0;
//	Epaper_Write_Data(0);
//	Epaper_Write_Command(0x4F);   // set RAM y address count to 0X199;
//	Epaper_Write_Data(0);
//	Epaper_Write_Data(0);
//	Epaper_Write_Command(0x24);   //write RAM for black(0)/white (1)
//	for(uint16_t i=0;i<(19*151);i++)
//	{
//		Epaper_Write_Data(datas[i]);
//	}
//	EPD_Update();

}

const uint8_t F6x8[92*6] ={
	0x00, 0x00, 0x00, 0x00, 0x00, 0x00,// sp
	0x00, 0x00, 0x00, 0x2f, 0x00, 0x00,// !
	0x00, 0x00, 0x07, 0x00, 0x07, 0x00,// "
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	0x14, 0x14, 0x14, 0x14, 0x14, 0x14,// horiz lines
};




void D_Init(st7567Handler* h)
{


//	RST=1;
	HAL_Delay(10);
//	RST=0;
	HAL_Delay(10);
//	RST=1;
	HAL_Delay(10);



	Dcmd(h, 0xe2);//soft reset

	HAL_Delay(10);


	Dcmd(h, 0x2c);  	//Control built-in power circuit ON	    VB
	Dcmd(h, 0x2e);  	//Control built-in power circuit ON	    VR
	Dcmd(h, 0x2f);  	//Control built-in power circuit ON	    VF

	HAL_Delay(10);


	Dcmd(h, 0xf8);  //Set booster level
	Dcmd(h, 0x00);  //Set  4X booster level

	Dcmd(h, 0x25);  //Select regulation resistor ratio
	Dcmd(h, 0x81);  	 //Setelectronic volume (EV) level
	Dcmd(h, dispContrast);  //Setelectronic volume (EV) level
	Dcmd(h, 0xa2);  //1/9bias
	Dcmd(h, 0xc8);  //Set output direction of COM
	Dcmd(h, 0xa0);  //Set scan direction of SEG
	Dcmd(h, 0xa4);  //Set normal display

	Dcmd(h, 0xa6);  //Set normal display

	Dcmd(h, 0x40);  //start line
	Dcmd(h, 0xaf);  //  display ON


}


void Set_Contrast_Control_Register(st7567Handler* h, uint8_t mod)
{
	Dcmd(h, 0x81);
	Dcmd(h, mod);
}


// Set page address 0~8
void Set_Page_Address(st7567Handler* h, uint8_t add)
{
    add=0xb0|add;
    Dcmd(h, add);
}

void Set_Column_Address(st7567Handler* h, uint8_t add)
{
	Dcmd(h, (0x10|(add>>4)));
	Dcmd(h, (0x0f&add));
}



void Set_Pos(st7567Handler* h, uint8_t x, uint8_t y)
{

	Dcmd(h, 0xb0+y);
	Dcmd(h, ((x&0xf0)>>4)|0x10);
	Dcmd(h, (x&0x0f));

}



//// ShowChar   size: 16/8
void ShowChar(st7567Handler* h, uint8_t x,uint8_t y,uint8_t chr)
{

	uint8_t c=0,i=0;
		c=chr-' ';
		if(x>Max_Column-1){
			x=0;
		}

		Set_Pos(h, x,y);
		for(i=0;i<6;i++)
			Ddat(h, F6x8[c*6+i]);

//		Ddat(F6x8[c]);
//		Ddat(F6x8[c+1]);
//		Ddat(F6x8[c+2]);
//		Ddat(F6x8[c+3]);
//		Ddat(F6x8[c+4]);
//		Ddat(F6x8[c+5]);
//		Ddat(F6x8[c+6]);

}


void ShowString(st7567Handler* h, uint8_t x,uint8_t y,uint8_t *chr)
{
	uint8_t j=0;
	while (chr[j]!='\0')
	{		ShowChar(h, x,y,chr[j]);
			x+=8;
		if(x>124)
		{
			x=0;
			y+=1;
		}
			j++;
	}
}



void Dcls(st7567Handler* h)
{
	uint8_t i,j;

	for(i=0;i<8;i++)
	{
		Set_Page_Address(h, i);
		Set_Column_Address(h, 0x00);
        for(j=0;j<132;j++)
		{
		    Ddat(h, 0x00);
		}

	}

}
